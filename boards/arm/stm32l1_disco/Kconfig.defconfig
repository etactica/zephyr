## boards/arm/stm32l1_disco/Kconfig.defconfig
```kconfig
# Kconfig - board configuration
#
# Copyright (c) 2019 eTactica ehf
#
# SPDX-License-Identifier: Apache-2.0
#

if BOARD_STM32L1_DISCO

config BOARD
	default "stm32l1_disco"

if UART_CONSOLE

config UART_1
	default y

endif # UART_CONSOLE

endif # BOARD_STM32L1_DISCO
```
